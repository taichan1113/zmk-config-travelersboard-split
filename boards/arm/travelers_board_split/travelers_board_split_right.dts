/dts-v1/;

#include "../travelers_board_split_common.dtsi"

/ {
    model = "travelers-board-split UF2 right peripheral (NINA-B302-00B)";
    compatible = "travelers-board-split-right";
};

&default_transform {
    col-offset = <6>;
};
