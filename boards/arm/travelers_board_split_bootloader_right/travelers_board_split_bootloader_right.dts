/dts-v1/;

#include "../travelers_board_split_bootloader_left/travelers_board_split_bootloader_left.dts"

/ {
    model = "travelers-board-split Bootloader right central (NINA-B302-00B)";
    compatible = "travelers-board-split-bootloader-right";
};

&default_transform {
    col-offset = <6>;
};
