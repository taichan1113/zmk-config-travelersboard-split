## Kconfig
```kconfig
# SPDX-License-Identifier: MIT

DT_COMPAT_TRAVELERS_BATTERY_VOLTAGE_DIVIDER := travelers,battery-voltage-divider

config TRAVELERS_BATTERY_VOLTAGE_DIVIDER
    bool "travelers-board-split switched battery voltage divider"
    default $(dt_compat_enabled,$(DT_COMPAT_TRAVELERS_BATTERY_VOLTAGE_DIVIDER))
    select ADC
    select SENSOR
    help
      Battery sensor for the P0.13-switched 1 Mohm / 1 Mohm divider.
```

## boards/arm/travelers_board_split/Kconfig
```kconfig
config BOARD_TRAVELERS_BOARD_SPLIT_LEFT
    bool

config BOARD_TRAVELERS_BOARD_SPLIT_RIGHT
    bool
```

## boards/arm/travelers_board_split/Kconfig.board
```kconfig
config BOARD_TRAVELERS_BOARD_SPLIT_LEFT
    bool "travelers-board-split UF2 left central"
    depends on SOC_NRF52840_QIAA

config BOARD_TRAVELERS_BOARD_SPLIT_RIGHT
    bool "travelers-board-split UF2 right peripheral"
    depends on SOC_NRF52840_QIAA
```

## boards/arm/travelers_board_split/Kconfig.defconfig
```kconfig
if BOARD_TRAVELERS_BOARD_SPLIT_LEFT || BOARD_TRAVELERS_BOARD_SPLIT_RIGHT

config ZMK_KEYBOARD_NAME
    default "travelers-split"

config BT_CTLR
    default BT

endif
```

## boards/arm/travelers_board_split_bootloader/Kconfig.board
```kconfig
config BOARD_TRAVELERS_BOARD_SPLIT_BOOTLOADER
    bool "travelers-board-split Bootloader variant"
    depends on SOC_NRF52840_QIAA
```

## boards/arm/travelers_board_split_bootloader_left/Kconfig.board
```kconfig
config BOARD_TRAVELERS_BOARD_SPLIT_BOOTLOADER_LEFT
    bool "travelers-board-split Bootloader left peripheral"
    depends on SOC_NRF52840_QIAA
```

## boards/arm/travelers_board_split_bootloader_left/Kconfig.defconfig
```kconfig
if BOARD_TRAVELERS_BOARD_SPLIT_BOOTLOADER_LEFT

config ZMK_KEYBOARD_NAME
    default "travelers-split"

config BT_CTLR
    default BT

endif
```

## boards/arm/travelers_board_split_bootloader_right/Kconfig.board
```kconfig
config BOARD_TRAVELERS_BOARD_SPLIT_BOOTLOADER_RIGHT
    bool "travelers-board-split Bootloader right central"
    depends on SOC_NRF52840_QIAA
```

## boards/arm/travelers_board_split_left/Kconfig.board
```kconfig
config BOARD_TRAVELERS_BOARD_SPLIT_LEFT
    bool "travelers-board-split UF2 left central"
    depends on SOC_NRF52840_QIAA
```

## boards/arm/travelers_board_split_left/Kconfig.defconfig
```kconfig
if BOARD_TRAVELERS_BOARD_SPLIT_LEFT

config ZMK_KEYBOARD_NAME
    default "travelers-split"

config BT_CTLR
    default BT

endif
```

## boards/arm/travelers_board_split_right/Kconfig.board
```kconfig
config BOARD_TRAVELERS_BOARD_SPLIT_RIGHT
    bool "travelers-board-split UF2 right peripheral"
    depends on SOC_NRF52840_QIAA
```

## config/west.yml
```yaml
manifest:
  defaults:
    revision: v0.3
  remotes:
    - name: zmkfirmware
      url-base: https://github.com/zmkfirmware
    - name: taichan1113
      url-base: https://github.com/taichan1113
  projects:
    - name: zmk
      remote: zmkfirmware
      import: app/west.yml
    - name: zmk-module-battery-voltage-divider
      remote: taichan1113
      revision: main
  self:
    path: config
```

## dts/bindings/sensor/travelers,battery-voltage-divider.yaml
```yaml
# SPDX-License-Identifier: MIT

description: |
  Battery sensor for a switched voltage divider. Unlike ZMK v0.3's built-in
  driver, the settling delay is configured by settle-delay-ms.

compatible: "travelers,battery-voltage-divider"

include: voltage-divider.yaml

properties:
  power-gpios:
    type: phandle-array
    required: true
    description: GPIO that enables the divider before sampling.
  settle-delay-ms:
    type: int
    required: true
    description: Time to wait after enabling the divider before sampling.
  empty-millivolts:
    type: int
    required: true
    description: Voltage reported as 0 percent.
  full-millivolts:
    type: int
    required: true
    description: Voltage reported as 100 percent.
```
